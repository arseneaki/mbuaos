## configs/mbuaos_defconfig
```kconfig
BR2_x86_64=y
BR2_TOOLCHAIN_BUILDROOT_GLIBC=y

BR2_TARGET_GENERIC_HOSTNAME="mbuaos"
BR2_TARGET_GENERIC_ISSUE="Welcome to MbuaOS"
BR2_ROOTFS_OVERLAY="board/mbuaos/overlay"

BR2_PACKAGE_DROPBEAR=y
BR2_PACKAGE_DNSMASQ=y
BR2_PACKAGE_NFTABLES=y
BR2_PACKAGE_IPROUTE2=y

BR2_TARGET_ROOTFS_EXT2=y
BR2_TARGET_ROOTFS_EXT2_4=y
BR2_TARGET_ROOTFS_EXT2_SIZE="120M"

BR2_LINUX_KERNEL=y
BR2_LINUX_KERNEL_USE_CUSTOM_CONFIG=y
BR2_LINUX_KERNEL_CUSTOM_VERSION=y
BR2_LINUX_KERNEL_CUSTOM_VERSION_VALUE="6.1.1"
BR2_LINUX_KERNEL_DEFCONFIG="x86_64"
BR2_LINUX_KERNEL_CUSTOM_CONFIG_FILE="board/mbuaos/linux.config"
```
